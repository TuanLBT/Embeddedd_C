#INCLUDE <TV_16F887.C>
#INCLUDE<TV_LCD.C>
UNSIGNED INT16 KQADC1, KQADC2, PRODUCT, DEM;
VOID LCD_HIENTHI()
{
   LCD_COMMAND(ADDR_LINE1); 
   LCD_DATA((KQADC1/1000)+0X30);
   LCD_DATA((KQADC1/100)%10+0X30);
   LCD_DATA((KQADC1/10)%10+0X30);
   LCD_DATA((KQADC1%10)+0X30);
   
   LCD_COMMAND(ADDR_LINE2); 
   LCD_DATA((PRODUCT/1000)+0X30);
   LCD_DATA((PRODUCT/100)%10+0X30);
   LCD_DATA((PRODUCT/10)%10+0X30);
   LCD_DATA((PRODUCT%10)+0X30);
}
VOID MAIN()
{
   DEM=0; PRODUCT = 0;
   SETUP_TIMER_0(T0_EXT_L_TO_H | T0_DIV_1);
   SET_TIMER0(0);
   SETUP_ADC(ADC_CLOCK_DIV_8);
   SETUP_ADC_PORTS(SAN0);

   WHILE(TRUE)
   {
   LCD_SETUP();
   SET_TRIS_E(0x00); SET_TRIS_D(0x00);
   
   SET_ADC_CHANNEL(0);
   KQADC1=READ_ADC();
   DELAY_MS(1);
   KQADC1= KQADC1 /2.046;
   
   SET_ADC_CHANNEL(1);
   KQADC2=READ_ADC();
   DELAY_MS(1);
   KQADC2= KQADC2 /2.046;
   
   LCD_HIENTHI();
   DELAY_MS(1000);
   DEM = GET_TIMER0();
   IF (DEM == 1) 
   {
      SET_TIMER0(0);PRODUCT ++;

      IF(PRODUCT == 1000) PRODUCT = 0;  
   }
   
   
   }
}
